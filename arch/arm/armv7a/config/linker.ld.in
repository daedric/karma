ENTRY(_start)

SECTIONS
{
     . = @RAM_START_ADDRESS@;
     __kernel_entry_point__ = @ENTRYPOINT_ADDRESS@;
     __ram_start_address__ = @RAM_START_ADDRESS@;
     . = ALIGN(4);

    .text :
    {
        @BOOTLOADER_OBJECT@
         . = ALIGN(4096);
        *(.text*)
        *(.gnu.linkonce.t*)
    }

    .ctors :
    {
        . = ALIGN(4096);
        start_ctors = .;
        *(.init_array);
        *(.ctors);
        end_ctors = .;
     }

     .dtors :
     {
        . = ALIGN(4096);
         start_dtors = .;
         *(.fini_array);
         *(.dtors);
         end_dtors = .;
      }

    .rodata :
    {
        *(.rodata .rodata*)
        *(.gnu.linkonce.r*)
        
    }

    .data :
    {
        *(.data)
    }

    .bss :
    {
        *(COMMON*)
        *(.bss)
        *(.gnu.linkonce.b*)
    }

    /DISCARD/ :
    {
        *(.comment)
        *(.ARM.exidx*)
        *(.ARM.attributes*)
    }
    
    . = ALIGN(0x4000);
    __kernel_end_mapping__ = .;
    __kernel_size_mapping__ = __kernel_end_mapping__ - __kernel_entry_point__;
}
